## configs/drann_glibc_defconfig
```kconfig
BR2_arm=y
BR2_cortex_a12=y
BR2_ARM_EABIHF=y
BR2_ARM_FPU_NEON_VFPV4=y
BR2_DL_DIR="$(TOPDIR)/../dl"
BR2_CCACHE=y
BR2_CCACHE_DIR="/home/user/build/ccache"
BR2_OPTIMIZE_3=y
BR2_ENABLE_SSP=y
BR2_FERTILIZE=y
BR2_TOOLCHAIN_BUILDROOT_GLIBC=y
BR2_GLIBC_VERSION_2_21=y
BR2_BINUTILS_VERSION_2_25_X=y
BR2_GCC_VERSION_5_X=y
BR2_TOOLCHAIN_BUILDROOT_CXX=y
BR2_GCC_ENABLE_LTO=y
BR2_GCC_ENABLE_GRAPHITE=y
BR2_ENABLE_LOCALE_PURGE=y
BR2_ENABLE_LOCALE_WHITELIST="C en_US"
BR2_GENERATE_LOCALE="C.UTF-8 POSIX.UTF-8 en.UTF-8 en_US.UTF-8 en_GB.UTF-8 en_CA.UTF-8"
BR2_TARGET_GENERIC_HOSTNAME="drann"
BR2_TARGET_GENERIC_ISSUE="omgwtfhax"
BR2_INIT_SYSTEMD=y
BR2_SYSTEM_BIN_SH_BASH=y
BR2_TARGET_GENERIC_GETTY_TERM="ansi"
BR2_TARGET_TZ_INFO=y
BR2_TARGET_LOCALTIME="America/Vancouver"
# BR2_PACKAGE_BUSYBOX is not set
BR2_PACKAGE_GZIP=y
BR2_PACKAGE_INFOZIP=y
BR2_PACKAGE_UNZIP=y
BR2_PACKAGE_BINUTILS=y
BR2_PACKAGE_BINUTILS_TARGET=y
BR2_PACKAGE_BSDIFF=y
BR2_PACKAGE_DIFFUTILS=y
BR2_PACKAGE_FINDUTILS=y
BR2_PACKAGE_GAWK=y
BR2_PACKAGE_GIT=y
BR2_PACKAGE_GNUCC=y
BR2_PACKAGE_GREP=y
BR2_PACKAGE_LIBTOOL=y
BR2_PACKAGE_MAKE=y
BR2_PACKAGE_MERCURIAL=y
BR2_PACKAGE_PATCH=y
BR2_PACKAGE_SED=y
BR2_PACKAGE_TAR=y
BR2_PACKAGE_CPIO=y
BR2_PACKAGE_LVM2=y
BR2_PACKAGE_LVM2_APP_LIBRARY=y
BR2_PACKAGE_PERL=y
BR2_PACKAGE_PYTHON=y
BR2_PACKAGE_PYTHON_BZIP2=y
BR2_PACKAGE_OPENSSL=y
BR2_PACKAGE_OPENSSL_BIN=y
BR2_PACKAGE_NCURSES_WCHAR=y
BR2_PACKAGE_NCURSES_TARGET_PANEL=y
BR2_PACKAGE_NCURSES_TARGET_FORM=y
BR2_PACKAGE_NCURSES_TARGET_MENU=y
BR2_PACKAGE_NCURSES_TARGET_PROGS=y
BR2_PACKAGE_BC=y
BR2_PACKAGE_IFUPDOWN=y
BR2_PACKAGE_RSYNC=y
BR2_PACKAGE_WGET=y
BR2_PACKAGE_WHICH=y
BR2_PACKAGE_ACL=y
BR2_PACKAGE_COREUTILS=y
BR2_PACKAGE_SYSTEMD_ALL_EXTRAS=y
BR2_PACKAGE_SYSTEMD_KDBUS=y
BR2_PACKAGE_SYSTEMD_NETWORKD=y
BR2_PACKAGE_SYSTEMD_TIMESYNCD=y
BR2_PACKAGE_SYSTEMD_SMACK_SUPPORT=y
BR2_PACKAGE_UTIL_LINUX_AGETTY=y
BR2_PACKAGE_UTIL_LINUX_EJECT=y
BR2_PACKAGE_UTIL_LINUX_FALLOCATE=y
BR2_PACKAGE_UTIL_LINUX_FSCK=y
BR2_PACKAGE_UTIL_LINUX_KILL=y
BR2_PACKAGE_UTIL_LINUX_LOGIN_UTILS=y
BR2_PACKAGE_UTIL_LINUX_LOSETUP=y
BR2_PACKAGE_UTIL_LINUX_NSENTER=y
BR2_PACKAGE_UTIL_LINUX_PIVOT_ROOT=y
BR2_PACKAGE_UTIL_LINUX_RESET=y
BR2_PACKAGE_UTIL_LINUX_SCHEDUTILS=y
BR2_PACKAGE_UTIL_LINUX_SETTERM=y
BR2_PACKAGE_UTIL_LINUX_SWITCH_ROOT=y
BR2_PACKAGE_VIM=y
BR2_TARGET_ROOTFS_TAR_GZIP=y
```

## package/autoconf/Config.in
```kconfig
config BR2_PACKAGE_AUTOCONF
	bool "autoconf"
	select BR2_PACKAGE_M4
	select BR2_PACKAGE_LIBTOOL
```

## package/automake/Config.in
```kconfig
config BR2_PACKAGE_AUTOMAKE
	bool "automake"
	select BR2_PACKAGE_AUTOCONF
	help
      automake
```

## package/gcc/Config.in
```kconfig
config BR2_GCC_ENABLE_IN_TARGET
	bool "gcc"
	default n
	help
	  GNU compiler collection.
```

## package/gnu-c/Config.in
```kconfig
config BR2_GCC_ENABLE_IN_TARGET
	bool "gcc"
	select BR2_GCC_NEEDS_MPC
	help
	  GNU compiler collection.
```

## package/gnucc/Config.in
```kconfig
config BR2_PACKAGE_GNUCC
	bool "gcc"
	select BR2_PACKAGE_MPC
	select BR2_PACKAGE_MPFR
	select BR2_PACKAGE_GMP
	help
	  GNU compiler collection.
```

## package/mercurial/Config.in
```kconfig
config BR2_PACKAGE_MERCURIAL
	bool "mercurial"
	depends on BR2_PACKAGE_PYTHON
	depends on BR2_PACKAGE_PYTHON_BZIP2
	depends on BR2_PACKAGE_PYTHON_HASHLIB
	depends on BR2_PACKAGE_PYTHON_ZLIB
```
